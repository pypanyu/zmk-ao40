## config/boards/shields/ao40/Kconfig.defconfig
```kconfig
if SHIELD_AO40_LEFT

config ZMK_KEYBOARD_NAME
    default "ao40"

config ZMK_SPLIT_ROLE_CENTRAL
    default y

endif

if SHIELD_AO40_LEFT || SHIELD_AO40_RIGHT

config ZMK_SPLIT
    default y

endif
```

## config/boards/shields/ao40/Kconfig.shield
```kconfig
config SHIELD_AO40_LEFT
    def_bool $(shields_list_contains,ao40_left)

config SHIELD_AO40_RIGHT
    def_bool $(shields_list_contains,ao40_right)
```

## config/west.yml
```yaml
manifest:   清单:
  remotes:   遥控器:
    - name: zmkfirmware   —名称：zmkfirmware
      url-base: https://github.com/zmkfirmware
  projects:   项目:
    - name: zmk
      remote: zmkfirmware   边远:zmkfirmware
      revision: main   主要修订:1
      import: app/west.yml   进口:app / west.yml
  self:   自我:
    path: config   路径:配置
```
